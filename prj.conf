## CMakeLists.txt
```
# Copyright (c) 2024 Samy Francelet

cmake_minimum_required(VERSION 3.13.1)
find_package(Zephyr REQUIRED HINTS $ENV{ZEPHYR_BASE})

project(matter_logic LANGUAGES C)

target_sources(matter_logic PRIVATE src/main.c)
```

## west.yml
```
# Copyright (c) 2024 Samy Francelet

manifest:
  remotes:
    - name: nrfconnect
      url-base: https://github.com/nrfconnect
  
  projects:
    - name: nrf
      repo-path: sdk-nrf
      remote: nrfconnect
      revision: v2.5.2
      import:
        - name-allowlist:
          - zephyr
          - mcuboot
          - hal_nordic
          - nrfxlib
          - matter
          - nrf-802154
          - openthread

  self:
    # This repository should be cloned to 
    path: app
```

## prj.conf
```kconfig
# Copyright (c) 2024 Samy Francelet

CONFIG_LOG=y
CONFIG_SHELL=y
```

## src/main.c
```c
// Copyright (c) 2024 Samy Francelet

#include <zephyr/kernel.h>
#include <app_version.h>

#include <zephyr/logging/log.h>
LOG_MODULE_REGISTER(matter_logic)

int main()
{
    LOG_INF("Starting Matter device\n\tboard: %s\n\tFirmware v%s", 
            CONFIG_BOARD, APP_VERSION_STRING);

    for (;;) {
        LOG_INF("Hello world!");
        k_sleep(K_SECONDS(1));
    }
}
```
